## template/sdkconfig.defaults
```kconfig
# -----------------------------------------------------------------------
# @serial_flasher_config
# -----------------------------------------------------------------------
CONFIG_ESPTOOLPY_PORT="/dev/ttyUSB0"
CONFIG_ESPTOOLPY_BAUD_230400B=y
CONFIG_ESPTOOLPY_BAUD=230400
CONFIG_ESPTOOLPY_FLASHSIZE_4MB=y
CONFIG_ESPTOOLPY_FLASHSIZE="4MB"
CONFIG_ESPTOOLPY_FLASHFREQ_80M=y
CONFIG_ESPTOOLPY_FLASHFREQ="80m"

# -----------------------------------------------------------------------
# @freertos
# -----------------------------------------------------------------------
CONFIG_FREERTOS_HZ=1000
CONFIG_FREERTOS_QUEUE_REGISTRY_SIZE=10
CONFIG_FREERTOS_USE_TRACE_FACILITY=y
CONFIG_FREERTOS_USE_STATS_FORMATTING_FUNCTIONS=y
CONFIG_FREERTOS_VTASKLIST_INCLUDE_COREID=y

# -----------------------------------------------------------------------
# @esp32-specific
# -----------------------------------------------------------------------
CONFIG_ESP32_DEFAULT_CPU_FREQ_240=y
CONFIG_ESP32_DEFAULT_CPU_FREQ_MHZ=240

# -----------------------------------------------------------------------
# @common_esp-related
# -----------------------------------------------------------------------
CONFIG_ESP_SYSTEM_EVENT_TASK_STACK_SIZE=3000
CONFIG_ESP_MAIN_TASK_STACK_SIZE=6000
CONFIG_ESP_TIMER_TASK_STACK_SIZE=2048

# -----------------------------------------------------------------------
# @spiffs_configuration
# -----------------------------------------------------------------------
CONFIG_SPIFFS_MAX_PARTITIONS=2

# -----------------------------------------------------------------------
# @wi-fi
# -----------------------------------------------------------------------
CONFIG_ESP32_WIFI_SW_COEXIST_ENABLE=n
CONFIG_ESP32_WIFI_TASK_PINNED_TO_CORE_1=y
CONFIG_ESP32_WIFI_IRAM_OPT=y
CONFIG_ESP32_WIFI_RX_IRAM_OPT=y

# -----------------------------------------------------------------------
# @lwip
# -----------------------------------------------------------------------
CONFIG_LWIP_TCPIP_TASK_AFFINITY_CPU1=y
CONFIG_LWIP_TCPIP_TASK_AFFINITY=0x1

# -----------------------------------------------------------------------
# @esp-mqtt_configurations
# -----------------------------------------------------------------------
CONFIG_MQTT_TASK_CORE_SELECTION_ENABLED=y
CONFIG_MQTT_USE_CORE_1=y

# -----------------------------------------------------------------------
# @bootloader_config
# -----------------------------------------------------------------------
CONFIG_BOOTLOADER_COMPILER_OPTIMIZATION_SIZE=y
CONFIG_BOOTLOADER_LOG_LEVEL_INFO=y
```
